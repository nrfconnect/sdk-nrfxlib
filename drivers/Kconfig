## mpsl/Kconfig
```kconfig
#
# Copyright (c) 2019 Nordic Semiconductor
#
# SPDX-License-Identifier: LicenseRef-Nordic-5-Clause
#

config HAS_MPSL_SUPPORT
	bool
	default y if SOC_SERIES_BSIM_NRFXX || SOC_SERIES_NRF52 || SOC_NRF5340_CPUNET || \
		SOC_NRF54H20_CPURAD || SOC_SERIES_NRF54L || SOC_SERIES_NRF71

config MPSL
	bool "Nordic Multi Protocol Service Layer (MPSL)"
	select ZERO_LATENCY_IRQS if !SOC_SERIES_BSIM_NRFXX
	select IEEE802154_NRF5_EXT_IRQ_MGMT if IEEE802154_NRF5
	select NRF_802154_MULTIPROTOCOL_SUPPORT if NRF_802154_RADIO_DRIVER
	select MULTITHREADING_LOCK
	select CLOCK_CONTROL_NRF if DT_HAS_NORDIC_NRF_CLOCK_ENABLED
	# temporary fix for CLOCK_CONTROL_NRF deprecation warnings, until MPSL rework
	select DEPRECATION_TEST if DT_HAS_NORDIC_NRF_CLOCK_ENABLED
	select NRF_GRTC_TIMER_AUTO_KEEP_ALIVE if NRF_GRTC_TIMER
	depends on HAS_MPSL_SUPPORT
	help
	  Use Nordic Multi Protocol Service Layer (MPSL) implementation,
	  providing services for single and multi-protocol implementations.

if MPSL

choice MPSL_BUILD_TYPE
	prompt "MPSL build type"
	default MPSL_BUILD_TYPE_LIB

config MPSL_BUILD_TYPE_LIB
	bool "Use library"

endchoice

endif # MPSL
```

## nrf71_wifi/zephyr/Kconfig
```kconfig
#
# Copyright (c) 2026 Nordic Semiconductor ASA
#
# SPDX-License-Identifier: LicenseRef-Nordic-5-Clause
#

if NRF71_WIFI

config NRF71_WIFI_PATCH
	bool "Include nRF7120 Wi-Fi ROM patches in the application image"
	depends on !IS_BOOTLOADER_IMG
	help
	  The Wi-Fi ROM patches are placed at fixed internal NVM addresses
	  required by the Wi-Fi Core. When MCUboot is enabled, the merged image
	  including the application and the Wi-Fi ROM patches is signed and
	  delivered as part of standard firmware updates.

	  RF parameters bundled with the selected patch version are included
	  in the same image.

	  Note: The regular ELF-derived artifacts do not contain Wi-Fi patch
	  data. Only the merged output used for programming and signing
	  includes the patches.

if NRF71_WIFI_PATCH

choice NRF71_WIFI_PATCH_VERSION
	prompt "nRF7120 Wi-Fi ROM patch version"
	default NRF71_WIFI_PATCH_VERSION_0_1_0
	help
	  Out-of-tree modules can add further choice entries with matching
	  NRF71_WIFI_PATCH_MANIFEST_FILE and NRF71_WIFI_PATCH_DTSI_FILE values.

config NRF71_WIFI_PATCH_VERSION_0_1_0
	bool "0.1.0"

endchoice

config NRF71_WIFI_PATCH_MANIFEST_FILE
	string
	default "$(ZEPHYR_NRFXLIB_MODULE_DIR)/nrf71_wifi/bins/0.1.0/manifest.json" if NRF71_WIFI_PATCH_VERSION_0_1_0
	help
	  Specifies the path to the Wi-Fi ROM patch manifest file.

config NRF71_WIFI_PATCH_DTSI_FILE
	string
	default "$(ZEPHYR_NRFXLIB_MODULE_DIR)/nrf71_wifi/bins/0.1.0/nrf7120_wifi_patch.dtsi" if NRF71_WIFI_PATCH_VERSION_0_1_0
	help
	  Specifies the path to the Wi-Fi ROM patch devicetree overlay file.

endif # NRF71_WIFI_PATCH

endif # NRF71_WIFI
```
