## Kconfig.nrfxlib
```kconfig
#
# Copyright (c) 2019 - 2020 Nordic Semiconductor
#
# SPDX-License-Identifier: LicenseRef-Nordic-5-Clause
#

menu "Nordic nrfxlib"

rsource "nrf_modem/Kconfig"
rsource "nfc/Kconfig"
rsource "mpsl/Kconfig"
rsource "crypto/Kconfig"
rsource "nrf_rpc/Kconfig"
rsource "zboss/Kconfig"
rsource "openthread/Kconfig"
rsource "nrf_802154/zephyr/Kconfig.nrfxlib"
rsource "gzll/Kconfig"
rsource "nrf_dm/Kconfig"
rsource "lc3/Kconfig"
rsource "nrf_fuel_gauge/Kconfig"

endmenu
```

## ble_controller/Kconfig
```kconfig
#
# Copyright (c) 2018 Nordic Semiconductor
#
# SPDX-License-Identifier: LicenseRef-BSD-5-Clause-Nordic
#

# BT_LL_CHOICE is declared in Zephyr and also here for a second time,
# now with additional properties. Note that the dependencies of the
# original config must be duplicated to not affect it's visibility.

if BT && BT_HCI

config BT_LL_NRFXLIB_VS_INCLUDE
	bool "Include nRF BLE Controller vendor specific HCI interface"
	help
	  Include nRF BLE Controller vendor specific HCI interface.

config BT_LL_NRFXLIB_DEFAULT
	bool "Select BT_LL_NRFXLIB as default BT_LL_CHOICE"
	help
	  Helper variable used to change the default link layer if
	  BT_CTLR is supported for the platform.

if BT_CTLR

choice BT_LL_CHOICE
	prompt "Bluetooth Link Layer Selection"
	default BT_LL_NRFXLIB if BT_LL_NRFXLIB_DEFAULT

config BT_LL_NRFXLIB
	bool "Nordic proprietary BLE Link Layer"
	select MPSL
	select ZERO_LATENCY_IRQS
	select BT_CTLR_LE_ENC_SUPPORT
	select BT_CTLR_EXT_REJ_IND_SUPPORT
	select BT_CTLR_SLAVE_FEAT_REQ_SUPPORT
	select BT_CTLR_PRIVACY_SUPPORT
	select BT_CTLR_EXT_SCAN_FP_SUPPORT
	select BT_CTLR_PHY_UPDATE_SUPPORT
	select BT_CTLR_CHAN_SEL_2_SUPPORT
	select BT_HAS_HCI_VS
	# This controller only supports nRF52 and nRF53, it does not support nRF51
	# or nRF91 (nRF91 doesn't even have the physical HW needed for BLE).
	depends on (SOC_SERIES_NRF52X || SOC_SERIES_NRF53X)
	help
	  Use Nordic BLE Link Layer implementation.

endchoice


if BT_LL_NRFXLIB

comment "Common BLE Controller module configuration"

choice BLE_CONTROLLER_VARIANT
	prompt "BLE Controller variant"
	default BLE_CONTROLLER_S112 if (SOC_NRF52810 || SOC_NRF52811)
	default BLE_CONTROLLER_S132 if SOC_NRF52832
	default BLE_CONTROLLER_S140 if SOC_NRF52840
	help
	  Select a BLE Controller variant.

config BLE_CONTROLLER_S112
	depends on (SOC_NRF52810 || SOC_NRF52811 || SOC_NRF52832)
	bool "s112"

config BLE_CONTROLLER_S132
	depends on (SOC_NRF52810 || SOC_NRF52832)
	bool "s132"
	select BT_CTLR_DATA_LEN_UPDATE_SUPPORT
	select BT_CTLR_ADV_EXT_SUPPORT

config BLE_CONTROLLER_S140
	depends on (SOC_NRF52811 || SOC_NRF52840 || SOC_NRF52833 || SOC_SERIES_NRF53X)
	select BT_CTLR_DATA_LEN_UPDATE_SUPPORT
	select BT_CTLR_ADV_EXT_SUPPORT
	bool "s140"

endchoice

endif # BT_LL_NRFXLIB
endif # BT_CTLR
endif # BT && BT_HCI
```

## bsdlib/Kconfig
```kconfig
config BSD_LIB
	bool
	default y
	depends on BSD_LIBRARY
	select NRF_OBERON
	help
	  Redefinition of BSD_LIBRARY inside nrfxlib.
```

## crypto/Kconfig
```kconfig
menu "Crypto libraries for nRF5x SOCs."

config NRFXLIB_CRYPTO
	bool

config HAS_HW_NRF_CC3XX
	def_bool HAS_HW_NRF_CC310 || HAS_HW_NRF_CC312

config NRF_OBERON
	bool "nrf_oberon SW crypto library for nRF5x."
	select NRFXLIB_CRYPTO if !BUILD_WITH_TFM
	help
	  This configuration is only available for direct use of nrf_oberon
	  To use, link with nrfxlib_crypto in CMake.

config NRF_CC310_BL
	bool "nrf_cc310_bl HW crypto library for nRF devices with CryptoCell CC310."
	select NRFXLIB_CRYPTO
	select FPU # The cc310_bl lib uses floating point registers.
	depends on !NORDIC_SECURITY_BACKEND
	help
	  This configuration is only available for direct use of nrf_cc3xx_bl
	  To use, link with nrfxlib_crypto in CMake.

menuconfig NRF_CC3XX_PLATFORM
	bool "nrf_cc3xx_platform HW crypto library for nRF devices with CryptoCell CC3xx."
	depends on HAS_HW_NRF_CC3XX && !BUILD_WITH_TFM
	select NRFXLIB_CRYPTO if !BUILD_WITH_TFM
	help
	  This configuration is only available for direct use of nrf_cc3xx_platform
	  To use, link with nrfxlib_crypto in CMake.

if NRF_CC3XX_PLATFORM

choice CC3XX_LOCK_VARIANT
	prompt "CC3XX lock variant"
	default CC3XX_MUTEX_LOCK

config CC3XX_MUTEX_LOCK
	bool "Use mutex variables for mutually exclusive access to CC3XX resources"
	help
	  Enables exclusive access to the ARM CryptoCell hardware using an RTOS
	  mutex that has priority inheritance. The mutex lock is safe across threads
	  and/or interrupts with different priority. Using an RTOS mutex comes
	  at a cost of lower performance.

config CC3XX_ATOMIC_LOCK
	bool "Use atomic variables for mutually exclusive access to CC3XX resources"
	help
	  Using atomic operations is the fastest way to ensure mutually exclusive
	  access to the ARM CryptoCell hardware.

	  Warning: If this configuration is set, every execution requiring use of
	  the ARM CryptoCell hardware must happen in the same priority. Calling into
	  mbed TLS APIs from a higher priority while an ongoing operation will lead
	  to undefined behavior. It is highy recommended to to do all cryptographic
	  operations in one single thread if this configuration is set.

config CC3XX_HW_MUTEX_LOCK
	bool "Use hardware mutex for mutually exclusive access to CC3XX resources"
	depends on SOC_NRF5340_CPUAPP
	help
	  A mutual exclusive peripheral is the fastest way to ensure mutually
	  exclusive access to the ARM CryptoCell hardware on platform which support
	  it. The MUTEX peripheral is nRF53 platform specific solution.

	  Warning: If this configuration is set, every execution requiring use of
	  the ARM CryptoCell hardware must happen in the same priority. Calling into
	  mbed TLS APIs from a higher priority while an ongoing operation will lead
	  to undefined behavior. It is highy recommended to to do all cryptographic
	  operations in one single thread if this configuration is set.

endchoice

endif

endmenu
```

## gzll/Kconfig
```kconfig
#
# Copyright (c) 2021 Nordic Semiconductor
#
# SPDX-License-Identifier: LicenseRef-Nordic-5-Clause
#

config GZLL
	bool "Gazell Link Layer"
	depends on SOC_SERIES_NRF52 || SOC_SERIES_NRF53
```

## lc3/Kconfig
```kconfig
#
# Copyright (c) 2022 Nordic Semiconductor ASA
#
# All rights reserved.
#
# SPDX-License-Identifier: Nordic-5-Clause
#
# Redistribution and use in source and binary forms, with or without
# modification, are permitted provided that the following conditions are met:
#
# 1. Redistributions of source code must retain the above copyright notice,
# this list of conditions and the following disclaimer.
#
# 2. Redistributions in binary form, except as embedded into a Nordic
#    Semiconductor ASA integrated circuit in a product or a software update for
#    such product, must reproduce the above copyright notice, this list of
#    conditions and the following disclaimer in the documentation and/or other
#    materials provided with the distribution.
#
# 3. Neither the name of Nordic Semiconductor ASA nor the names of its
#    contributors may be used to endorse or promote products derived from this
#    software without specific prior written permission.
#
# 4. This software, with or without modification, must only be used with a
#    Nordic Semiconductor ASA integrated circuit.
#
# 5. Any software provided in binary form under this license must not be
# reverse engineered, decompiled, modified and/or disassembled.
#
# THIS SOFTWARE IS PROVIDED BY NORDIC SEMICONDUCTOR ASA "AS IS" AND ANY EXPRESS
# OR IMPLIED WARRANTIES, INCLUDING, BUT NOT LIMITED TO, THE IMPLIED WARRANTIES
# OF MERCHANTABILITY, NONINFRINGEMENT, AND FITNESS FOR A PARTICULAR PURPOSE ARE
# DISCLAIMED. IN NO EVENT SHALL NORDIC SEMICONDUCTOR ASA OR CONTRIBUTORS BE
# LIABLE FOR ANY DIRECT, INDIRECT, INCIDENTAL, SPECIAL, EXEMPLARY, OR
# CONSEQUENTIAL DAMAGES (INCLUDING, BUT NOT LIMITED TO, PROCUREMENT OF
# SUBSTITUTE GOODS OR SERVICES; LOSS OF USE, DATA, OR PROFITS; OR BUSINESS
# INTERRUPTION) HOWEVER CAUSED AND ON ANY THEORY OF LIABILITY, WHETHER IN
# CONTRACT, STRICT LIABILITY, OR TORT (INCLUDING NEGLIGENCE OR OTHERWISE)
# ARISING IN ANY WAY OUT OF THE USE OF THIS SOFTWARE, EVEN IF ADVISED OF THE
# POSSIBILITY OF SUCH DAMAGE.
#

config SW_CODEC_LC3_T2_SOFTWARE
	bool "Select the T2 Software LC3 codec"
	depends on FP_HARDABI

if SW_CODEC_LC3_T2_SOFTWARE

config LC3_PLC_DISABLED
	bool "Override the decoded frame with zeroes if PLC was applied"
	default n

config LC3_ENC_CHAN_MAX
	int "Max number of encoder channels"
	default 1

config LC3_DEC_CHAN_MAX
	int "Max number of decoder channels"
	default 1

menu "Encoder sample rates"

config LC3_ENC_SAMPLE_RATE_8KHZ_SUPPORT
	bool "Support encoding 8 kHz"
	default y

config LC3_ENC_SAMPLE_RATE_16KHZ_SUPPORT
	bool "Support encoding 16 kHz"
	default y

config LC3_ENC_SAMPLE_RATE_24KHZ_SUPPORT
	bool "Support encoding 24 kHz"
	default y

config LC3_ENC_SAMPLE_RATE_32KHZ_SUPPORT
	bool "Support encoding 32 kHz"
	default y

config LC3_ENC_SAMPLE_RATE_441KHZ_SUPPORT
	bool "Support encoding 44.1 kHz"
	default y

config LC3_ENC_SAMPLE_RATE_48KHZ_SUPPORT
	bool "Support encoding 48 kHz"
	default y

endmenu #Encoder sample rates

#----------------------------------------------------------------------------#
menu "Decoder sample rates"

config LC3_DEC_SAMPLE_RATE_8KHZ_SUPPORT
	bool "Support decoding 8 kHz"
	default y

config LC3_DEC_SAMPLE_RATE_16KHZ_SUPPORT
	bool "Support decoding 16 kHz"
	default y

config LC3_DEC_SAMPLE_RATE_24KHZ_SUPPORT
	bool "Support decoding 24 kHz"
	default y

config LC3_DEC_SAMPLE_RATE_32KHZ_SUPPORT
	bool "Support decoding 32 kHz"
	default y

config LC3_DEC_SAMPLE_RATE_441KHZ_SUPPORT
	bool "Support decoding 44.1 kHz"
	default y

config LC3_DEC_SAMPLE_RATE_48KHZ_SUPPORT
	bool "Support decoding 48 kHz"
	default y

endmenu #Decoder sample rates

endif # SW_CODEC_LC3_T2_SOFTWARE
```

## lib/Kconfig
```kconfig
#
# Copyright (c) 2018 Nordic Semiconductor
#
# SPDX-License-Identifier: BSD-5-Clause-Nordic
#

config NRFXLIB_BLE
	bool
	prompt "Enable BLE"
	default n
	help
	  Enable BLE functionality

if NRFXLIB_BLE
rsource "ble/Kconfig"
endif # NRFXLIB_BLE

config NRFXLIB_NFC
	bool
	prompt "Enable NFC"
	default n
	help
	  Enable NFC functionality

if NRFXLIB_NFC
rsource "nfc/Kconfig"
endif # NRFXLIB_BLE
```

## lib/cortex-m4/Kconfig
```kconfig
#
# Copyright (c) 2018 Nordic Semiconductor
#
# SPDX-License-Identifier: BSD-5-Clause-Nordic
#

menu "cortex-m4"

rsource "soft-float/Kconfig"

endmenu
```

## lib/cortex-m4/soft-float/nfc/Kconfig
```kconfig
#
# Copyright (c) 2018 Nordic Semiconductor
#
# SPDX-License-Identifier: BSD-5-Clause-Nordic
#

# Kconfig - common module configuration options

comment "Common NFC module configuration"

config NFC_T2T_HAL_ENABLED
	bool
	prompt "Enable HAL for NFC Type 2 Tag library"
	default n
	help
		Enable Hardware Abstraction Layer for NFC Type 2 Tag library.

config NFC_T4T_HAL_ENABLED
	bool
	prompt "Enable HAL for NFC Type 4 Tag library"
	default n
	help
		Enable Hardware Abstraction Layer for NFC Type 4 Tag library.

config NFCT_IRQ_PRIORITY
	int
	prompt "Interrupt priority"
	range 0 6
	default 6
	help
		Sets NFC interrupt priority.
		Levels are from 0 (highest priority) to 7 (lowest priority)

config HAL_NFC_LOG_LEVEL
	int
	prompt "Log severity level for NFC HAL library"
	range 0 4
	default 0
	help
		Sets log severity level for NFC Module.
		Levels are:
		- 0 OFF, do not write
		- 1 ERROR, only write SYS_LOG_ERR
		- 2 WARNING, write SYS_LOG_WRN in addition to previous level
		- 3 INFO, write SYS_LOG_INF in addition to previous levels
		- 4 DEBUG, write SYS_LOG_DBG in addition to previous levels
```

## nfc/Kconfig
```kconfig
#
# Copyright (c) 2018-2025 Nordic Semiconductor
#
# SPDX-License-Identifier: LicenseRef-Nordic-5-Clause
#

choice NFC_LIBRARY_SOURCE
	prompt "Source of the NFC Type 2 / Type 4 tag libraries"
	default NFC_LIBRARY_SOURCE_NRFXLIB
	help
	  Prebuilt archives come from sdk-nrfxlib. Internal builds compile the same
	  API from the nfc-library repository (Zephyr integration).

config NFC_LIBRARY_SOURCE_NRFXLIB
	bool "Prebuilt (sdk-nrfxlib)"

endchoice

config NFC_T2T_NRFXLIB
	bool "NFC Type 2 Tag library"

config NFC_T4T_NRFXLIB
	bool "NFC Type 4 Tag library"
```

## nrf71_wifi/Kconfig
```kconfig
#
# Copyright (c) 2025 Nordic Semiconductor
#
# SPDX-License-Identifier: LicenseRef-Nordic-5-Clause
#
menu "nrf71_Wi-Fi firmware interface library"

config NRF71_WIFI
	bool
	default y
endmenu
```
