## nrf_802154/zephyr/Kconfig.nrfxlib
```kconfig
#
# Copyright (c) 2020 Nordic Semiconductor ASA
#
# SPDX-License-Identifier: LicenseRef-Nordic-5-Clause
#

choice NRF_802154_SOURCE
	prompt "Source of the IEEE 802.15.4 radio driver"
	default NRF_802154_SOURCE_NRFXLIB

config NRF_802154_SOURCE_NRFXLIB
	bool "sdk-nrfxlib"

endchoice # NRF_802154_SOURCE

if NRF_802154_RADIO_DRIVER

config NRF_802154_ENCRYPTION
	bool "nRF 802.15.4 AES-CCM* authentication & encryption"
	depends on !CRYPTO_NRF_ECB
	select NRF_802154_IE_WRITER
	select NRF_802154_SECURITY_WRITER
	help
		Enable module for encryption and authentication of outgoing frames and Acks.

config NRF_802154_IE_WRITER
	bool "Information element writer"
	help
		Enable data injection for some Information Element types.

config NRF_802154_SECURITY_WRITER
	bool "Security frame counter writer"
	help
		Enable injection of security frame counter.

config NRF_802154_TX_DIAGNOSTIC_MODE
	bool "TX diagnostic mode"
	help
		Disables strict frame validation.
		When this option is disabled the nRF 802.154 Radio Driver performs strict frame
		format validation of any frame that is to be transmitted. Frames that do not conform
		the IEEE 802.15.4 MAC frame format will be discarded on transmit attempts.
		When this option is enabled the validation of frame format is disabled what allows
		for sending arbitrary frames. The functionality set of the radio driver is reduced.
		The IE writer, security writer, encryption, and TX timestamp modules cannot be used.

config NRF_802154_CSMA_CA_MIN_BE_DEFAULT
	int "Minimum CSMA-CA backoff exponent (BE)"
	default 3
	help
		The default minimum value of the backoff exponent (BE) in the CSMA-CA algorithm.

config NRF_802154_CSMA_CA_MAX_BE_DEFAULT
	int "Maximum CSMA-CA backoff exponent (BE)"
	default 5
	help
		The default maximum value of the backoff exponent (BE) in the CSMA-CA algorithm.

config NRF_802154_CSMA_CA_MAX_CSMA_BACKOFFS_DEFAULT
	int "Maximum CSMA-CA backoff attempts"
	default 4
	help
		The default maximum number of backoffs that the CSMA-CA algorithm will attempt
		before declaring a channel access failure.

choice NRF_802154_SL_TYPE
	prompt "nRF 802.15.4 Service Layer selection"
	default NRF_802154_SL
	help
		Select implementation of nRF 802.15.4 Service Layer.

config NRF_802154_SL
	bool "Nordic proprietary nRF 802.15.4 Service Layer."
	select MPSL
	select ZERO_LATENCY_IRQS if !SOC_SERIES_BSIM_NRFXX
	select DYNAMIC_INTERRUPTS
	select SENSOR if NRF_802154_TEMPERATURE_UPDATE
	select TEMP_NRF5_MPSL if NRF_802154_TEMPERATURE_UPDATE
	select NRFX_GPPI
	depends on !NRF_802154_SOURCE_HAL_NORDIC
	help
		Use of Nordic Semiconductor proprietary implementation of nRF 802.15.4 Service Layer.
		This implementation enables advanced features of nRF 802.15.4 Radio Driver.

endchoice # NRF_802154_SL_TYPE

if NRF_802154_SL

config NRF_802154_SL_LPTIMER_RTC
	def_bool y
	depends on NRF_RTC_TIMER

config NRF_802154_SL_HPTIMER
	def_bool y
	depends on SOC_SERIES_NRF52X || SOC_SERIES_NRF53X

endif # NRF_802154_SL

endif # NRF_802154_RADIO_DRIVER

if NRF_802154_RADIO_DRIVER || NRF_802154_SERIALIZATION

config NRF_802154_CCAIDLE_TO_TXEN_EXTRA_TIME_US
	int "Additional delay between triggering the TXEN task after the CCAIDLE event."
	default 5 if SOC_COMPATIBLE_NRF54LX && (MPSL_FEM_NRF2220 || MPSL_FEM_NRF2240)
	default 0
	help
	  Value of this option is passed to the `NRF_802154_CCAIDLE_TO_TXEN_EXTRA_TIME_US`
	  configuration macro of the nRF 802.15.4 Radio Driver.
	  Please refer to the documentation of that macro.

config NRF_802154_ACK_TIMEOUT_CUSTOM_US
	int "nRF 802.15.4 ACK timeout"
	default 0
	range 0 2000
	help
	  Set the custom value of ACK timeout in the nRF 802.15.4 Radio Driver module.
	  It is not recommended to change this setting for anything but testing purposes.
	  Setting this value too low will cause the Radio Driver to never receive ACK frames
	  and setting it too high will increase current consumption. Set this value to 0 to
	  use the default and recommended value of the ACK timeout.

config NRF_802154_TX_TIMESTAMP_PROVIDER_ENABLED
    bool "Enable Transmit Timestamp Feature"
    help
        Enable Transmit Timestamp feature.

endif # NRF_802154_RADIO_DRIVER || NRF_802154_SERIALIZATION
```

## nrf_802154_sl/Kconfig
```kconfig
#
# Copyright (c) 2020 Nordic Semiconductor
#
# SPDX-License-Identifier: LicenseRef-BSD-5-Clause-Nordic
#

if NRF_802154_RADIO_DRIVER

choice NRF_802154_SL_CHOICE
	prompt "nRF 802.15.4 Service Layer selection"
	default NRF_802154_SL
	help
		Select implementation of nRF 802.15.4 Service Layer.

config NRF_802154_SL
	bool "Nordic proprietary nRF 802.15.4 Service Layer."
	select MPSL
	select ZERO_LATENCY_IRQS
	select DYNAMIC_INTERRUPTS
	help
		Use of Nordic Semiconductor proprietary implementation of nRF 802.15.4 Service Layer.
		This implementation enables advanced features of nRF 802.15.4 Radio Driver.

endchoice # NRF_802154_SL_CHOICE

endif # NRF_802154_RADIO_DRIVER
```

## nrf_dm/Kconfig
```kconfig
#
# Copyright (c) 2021 Nordic Semiconductor
#
# SPDX-License-Identifier: LicenseRef-Nordic-5-Clause
#

config NRF_DM
	bool "nRF DM (Distance Measurement) library [EXPERIMENTAL]"
	select FPU if !SOC_NRF5340_CPUNET
	select CMSIS_DSP
	select CMSIS_DSP_FASTMATH
	select CMSIS_DSP_MATRIX
	select CMSIS_DSP_STATISTICS
	select CMSIS_DSP_TRANSFORM
	select EXPERIMENTAL
	help
		Enable nRF DM (Distance Measurement) library
```

## nrf_fuel_gauge/Kconfig
```kconfig
#
# Copyright (c) 2023 Nordic Semiconductor
#
# SPDX-License-Identifier: LicenseRef-Nordic-5-Clause
#

config NRF_FUEL_GAUGE
	bool "Enable nRF Fuel Gauge library"
	select REQUIRES_FULL_LIBC

if NRF_FUEL_GAUGE

choice NRF_FUEL_GAUGE_VARIANT
	prompt "nRF Fuel Gauge variant"
	default NRF_FUEL_GAUGE_VARIANT_SECONDARY_CELL

config NRF_FUEL_GAUGE_VARIANT_PRIMARY_CELL
	bool "Primary cell"

config NRF_FUEL_GAUGE_VARIANT_SECONDARY_CELL
	bool "Secondary cell"

endchoice

endif # NRF_FUEL_GAUGE
```

## nrf_modem/Kconfig
```kconfig
#
# Copyright (c) 2023 Nordic Semiconductor
#
# SPDX-License-Identifier: LicenseRef-Nordic-5-Clause
#
menu "nrf_modem (Modem library)"

# Selected by NRF_MODEM_LIB in sdk-nrf
config NRF_MODEM
	bool
	select NRFX_IPC if (SOC_SERIES_NRF91X || ZTEST)
	select REQUIRES_FULL_LIBC

if NRF_MODEM

choice NRF_MODEM_BUILD_STRATEGY
	prompt "Build strategy"

config NRF_MODEM_LINK_BINARY
	bool "Link binary"

endchoice # NRF_MODEM_BUILD_STRATEGY

choice
	prompt "Variant"
	help
	  Choose which binary variant to link with: cellular or DECT PHY.

config NRF_MODEM_LINK_BINARY_CELLULAR
	bool "Cellular"

config NRF_MODEM_LINK_BINARY_DECT_PHY
	select EXPERIMENTAL
	bool "DECT PHY"

endchoice

config NRF_MODEM_LOG
	bool "Link binary with logs"
	help
	  Links the application with the library version capable of emitting logs.
	  This increases the final size of the application.

endif # NRF_MODEM

config NRF_MODEM_SHMEM_CTRL_SIZE
	hex
	default 0x728 if NRF_MODEM_LINK_BINARY_DECT_PHY
	default 0x4e8

endmenu # nrf_modem
```

## nrf_rpc/Kconfig
```kconfig
#
# Copyright (c) 2020 Nordic Semiconductor
#
# SPDX-License-Identifier: LicenseRef-Nordic-5-Clause
#

menuconfig NRF_RPC
	bool "nRF RPC (Remote Procedure Call) library"
	help
	  Enable nRF RPC (Remote Procedure Call) library

if NRF_RPC

config NRF_RPC_CBOR
	bool "Add CBOR layer"
	default y
	select ZCBOR
	select ZCBOR_STOP_ON_ERROR
	help
	  Adds API that helps use of CBOR library for data serialization.

config NRF_RPC_ZCBOR_BACKUPS
	int "Number of ZCBOR backups"
	default 0
	help
	  ZCBOR needs to take a backup for each list/map. The application should
	  configure this to be the maximum list depth expected in the CBOR data.
	  E.g., if we have a nested list (2 levels deep) then ZCBOR will need 2
	  backup states.

config NRF_RPC_CMD_CTX_POOL_SIZE
	int "Number of available context structures for commands"
	default 8
	range 2 32
	help
	  nRF RPC need to store some data to handle commands. Pool of contexts
	  is created to avoid dynamic memory allocation. Setting this value too
	  low will cause unnecessary waits for available context. Minimum value
	  that is ensured to work without waiting is the sum of the number of
	  threads in both local and remote pool.

config NRF_RPC_GROUP_INIT_WAIT_TIME
	int "Group initialization timeout in milliseconds"
	default 1000
	help
	  The number of milliseconds to wait for the remote cores to send group
	  init packets with destination group IDs. Set to -1 to wait forever.

config NRF_RPC_THREAD_POOL_SIZE
	int "Number of threads in local thread pool"
	default 3
	range 1 32
	help
	  Thread pool is used to execute commands and events that arrived from
	  the remote side. If there is no available threads then remote side
	  will wait.

endif # NRF_RPC
```

## nrf_security/Kconfig
```kconfig
#
# Copyright (c) 2019-2022 Nordic Semiconductor
#
# SPDX-License-Identifier: LicenseRef-Nordic-5-Clause
#

menu "nrf_security module"

config NORDIC_SECURITY_PROMPTLESS
	bool
	default y if BUILD_WITH_TFM
	help
	  Internal setting to disable the Nordic security backend
	  This setting is Kconfig internal that must be used by subsystems that
	  provides nRF Security selection groups.


config NORDIC_SECURITY_BACKEND
	bool
	prompt "Use nrf_security module" if !NORDIC_SECURITY_PROMPTLESS
	depends on SOC_FAMILY_NRF
	select NRF_SECURITY
	select MBEDTLS_LEGACY_CRYPTO_C
	select OBERON_BACKEND
	help
	  Using this configuration enables legacy support for mbed TLS APIs
	  This configuration is not to be used for PSA API support.
	  Note that this will enable nrf_oberon by default. Multiple backends is
	  not supported.

config NRF_SECURITY
	bool
	prompt "Use nrf_security module" if !PSA_PROMPTLESS
	depends on SOC_FAMILY_NRF
	default y
	select ENTROPY_GENERATOR
	help
	  Set this configuration to enable nrf_security module. This provides
	  Arm PSA cryptography APIs with RNG support (optionally).

if NRF_SECURITY

config MBEDTLS_CFG_FILE
	string "mbed TLS configuration file"
	default "nrf-config.h"
	help
	  Name of the config file for mbed TLS. This configuration file is used
	  in configurations with or without PSA APIs supported.

config MBEDTLS_USER_CONFIG_FILE
	string "mbed TLS user configuration file"
	default "nrf-config-user.h"
	help
	  Name of the file that will contain additional configurations for mbed TLS.
	  This file may be generated and will contain PSA configurations if PSA APIs
	  are generated in the system. This file is empty if legacy support is used.

config GENERATE_MBEDTLS_CFG_FILE
	bool
	prompt "Generate mbed TLS config files"
	default y
	help
	  nrf_security will generate mbed TLS configuration file(s)
	  based on the selection of configuration options in Kconfig.
	  However, if the generated configuration file needs custom
	  adjustments, this setting can be used to disable generating the
	  mbed TLS configuration file. Only disable this setting if you know
	  what you are doing.

config MBEDTLS_ENABLE_HEAP
	bool "Enable global heap for mbed TLS"
	default y if BUILD_WITH_TFM
	help
	  This option enables the mbedtls to use the heap. This setting must
	  be global so that various applications and libraries in Zephyr do not
	  try to do this themselves as there can be only one heap defined
	  in mbedtls. If this is enabled, then the Zephyr will, during the device
	  startup, initialize the heap automatically.

config MBEDTLS_HEAP_SIZE
	int "Heap size for mbed TLS"
	default 15360 if OPENTHREAD_NRF_SECURITY
	default 512
	depends on MBEDTLS_ENABLE_HEAP
	help
	  Heap size for mbed TLS in bytes.
	  For streaming communication with arbitrary (HTTPS) servers on the
	  Internet, 32KB + overheads (up to another 20KB) may be needed.
	  Ensure to adjust the heap size according to the need of the
	  application.

# Include TLS/DTLS and x509 configurations
rsource "Kconfig.tls"

# Include PSA Crypto configurations
rsource "Kconfig.psa"

# Include Legacy mbed TLS configurations
rsource "Kconfig.legacy"

endif # NRF_SECURITY

endmenu
```

## nrf_security/Kconfig.psa
```kconfig
#
# Copyright (c) 2021 Nordic Semiconductor ASA
#
# SPDX-License-Identifier: LicenseRef-Nordic-5-Clause
#

menu "PSA API support"

config MBEDTLS_PSA_CRYPTO_SPM
	bool
	help
	  Configation that enables alternate naming of mbedcrypto symbols in
	  scope of TF-M build (Prefixes with mbedcrypto__)

config MBEDTLS_PSA_CRYPTO_STORAGE_C
	bool "PSA storage for persistent keys" if !BUILD_WITH_TFM
	default y if BUILD_WITH_TFM
	help
	  Corresponds to MBEDTLS_PSA_CRYPTO_STORAGE_C setting in mbed TLS config file.

config MBEDTLS_USE_PSA_CRYPTO
	bool "PSA APIs for X.509 and TLS library"
	default y if BUILD_WITH_TFM
	select NRF_SECURITY_ADVANCED
	imply MBEDTLS_PK_WRITE_C
	help
	  Corresponds to MBEDTLS_USE_PSA_CRYPTO setting in mbed TLS config file.

menuconfig PSA_NATIVE_ITS
	bool "PSA native Internal Trusted Storage"
	depends on MBEDTLS_PSA_CRYPTO_STORAGE_C
	depends on !BUILD_WITH_TFM

if PSA_NATIVE_ITS

choice
	prompt "Backend selection for PSA native ITS"
	# Please move this depends to the specific choice configuration when more
	# than one choice is available
	depends on SETTINGS && !SETTINGS_NONE
	help
	  Select backend for PSA native Internal Trusted Storage

config CHOICE_PSA_EITS_BACKEND_ZEPHYR_SETTINGS
	bool "Zephyr Settings"
	select PSA_EITS_BACKEND_ZEPHYR

endchoice

menuconfig PSA_EITS_BACKEND_ZEPHYR
	bool "Native ITS backend based on Zephyr Settings subsystem"
	depends on CHOICE_PSA_EITS_BACKEND_ZEPHYR_SETTINGS
	help
	  Enable to get access for flashing operation based on Zephyr Settings
	  subsystem.

if PSA_EITS_BACKEND_ZEPHYR

config PSA_EITS_READ_BUFF_SIZE
	int "The size of the buffer used when reading with an offset"
	default 2048

module = PSA_EITS_BACKEND_ZEPHYR
module-str = PSA EITS Zephyr backend
source "${ZEPHYR_BASE}/subsys/logging/Kconfig.template.log_config"

endif # PSA_EITS_BACKEND_ZEPHYR

endif # PSA_NATIVE_ITS

endmenu
```
