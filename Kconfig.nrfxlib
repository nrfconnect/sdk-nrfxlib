## nrf_security/src/drivers/nrf_oberon/Kconfig
```kconfig
#
# Copyright (c) 2021-2022 Nordic Semiconductor
#
# SPDX-License-Identifier: LicenseRef-Nordic-5-Clause
#

menuconfig PSA_CRYPTO_DRIVER_OBERON
    bool
    prompt "PSA Oberon Driver" if !PSA_PROMPTLESS
    default y #if !CRYPTOCELL_USABLE
    select NRF_OBERON
	help
	  Enable PSA Driver for nrf_oberon

if PSA_CRYPTO_DRIVER_OBERON

# MBEDTLS_PSA_BUILTIN_ALG_CBC_MAC - Currently not supported

config PSA_CRYPTO_DRIVER_HAS_CIPHER_SUPPORT_OBERON
	bool
	default y
	depends on PSA_CRYPTO_DRIVER_ALG_CBC_NO_PADDING_OBERON || \
		   PSA_CRYPTO_DRIVER_ALG_CBC_PKCS7_OBERON || \
		   PSA_CRYPTO_DRIVER_ALG_ECB_NO_PADDING_OBERON || \
		   PSA_CRYPTO_DRIVER_ALG_CTR_OBERON

config PSA_CRYPTO_DRIVER_HAS_AEAD_SUPPORT_OBERON
	bool
	default y
	depends on PSA_CRYPTO_DRIVER_ALG_CCM_OBERON || \
		   PSA_CRYPTO_DRIVER_ALG_GCM_OBERON || \
		   PSA_CRYPTO_DRIVER_ALG_CHACHA20_POLY1305_OBERON

# PSA_CRYPTO_DRIVER_HAS_MAC_SUPPORT_OBERON - Currently not supported

config PSA_CRYPTO_DRIVER_HAS_HASH_SUPPORT_OBERON
	bool
	default y
	depends on PSA_CRYPTO_DRIVER_ALG_SHA_1_OBERON	|| \
		   PSA_CRYPTO_DRIVER_ALG_SHA_224_OBERON	|| \
		   PSA_CRYPTO_DRIVER_ALG_SHA_256_OBERON	|| \
		   PSA_CRYPTO_DRIVER_ALG_SHA_384_OBERON	|| \
		   PSA_CRYPTO_DRIVER_ALG_SHA_512_OBERON

# PSA_CRYPTO_DRIVER_HAS_ASYM_ENCRYPT_SUPPORT_OBERON - Currently not supported

config PSA_CRYPTO_DRIVER_HAS_ASYM_SIGN_SUPPORT_OBERON
	bool
	default y
	depends on PSA_CRYPTO_DRIVER_ALG_DETERMINISTIC_ECDSA_OBERON	|| \
		   PSA_CRYPTO_DRIVER_ALG_ECDSA_OBERON

config PSA_CRYPTO_DRIVER_HAS_ECC_SUPPORT_OBERON
	bool
	default y
	depends on PSA_CRYPTO_DRIVER_ALG_DETERMINISTIC_ECDSA_OBERON 	|| \
		   PSA_CRYPTO_DRIVER_ALG_ECDSA_OBERON			|| \
		   PSA_CRYPTO_DRIVER_ALG_ECDH_OBERON

config PSA_CRYPTO_DRIVER_HAS_ACCEL_KEY_TYPES_OBERON
	bool
	default y
	depends on PSA_CRYPTO_DRIVER_HAS_ASYM_SIGN_SUPPORT_OBERON	|| \
		   PSA_CRYPTO_DRIVER_HAS_AEAD_SUPPORT_OBERON		|| \
		   PSA_CRYPTO_DRIVER_HAS_CIPHER_SUPPORT_OBERON

config PSA_CRYPTO_DRIVER_ALG_CBC_NO_PADDING_OBERON
	bool
	prompt "PSA CBC support (without padding) - oberon" if !PSA_PROMPTLESS
	default y if !PSA_DEFAULT_OFF && PSA_WANT_ALG_CBC_NO_PADDING && \
		    !PSA_CRYPTO_DRIVER_ALG_CBC_NO_PADDING_CC3XX

config PSA_CRYPTO_DRIVER_ALG_CBC_PKCS7_OBERON
	bool
	prompt "PSA CBC support (with PKCS#7 padding) - oberon" if !PSA_PROMPTLESS
	default y if !PSA_DEFAULT_OFF && PSA_WANT_ALG_CBC_PKCS7 && \
		    !PSA_CRYPTO_DRIVER_ALG_CBC_PKCS7_CC3XX

config PSA_CRYPTO_DRIVER_ALG_CCM_OBERON
	bool
	prompt "PSA AES CCM support - oberon" if !PSA_PROMPTLESS
	default y if !PSA_DEFAULT_OFF && PSA_WANT_ALG_CCM && \
		     !PSA_CRYPTO_DRIVER_ALG_CCM_CC3XX

config PSA_CRYPTO_DRIVER_ALG_CHACHA20_POLY1305_OBERON
	bool
	prompt "PSA ChaCha20/Poly1305 support - oberon" if !PSA_PROMPTLESS
	default y if !PSA_DEFAULT_OFF && PSA_WANT_ALG_CHACHA20_POLY1305 && \
		     !PSA_CRYPTO_DRIVER_ALG_CHACHA20_POLY1305_CC3XX

# PSA_CRYPTO_DRIVER_ALG_CMAC_OBERON - Currently not supported

config PSA_CRYPTO_DRIVER_ALG_CTR_OBERON
	bool
	prompt "PSA AES CTR mode support - oberon" if !PSA_PROMPTLESS
	default y if !PSA_DEFAULT_OFF && PSA_WANT_ALG_CTR && \
		     !PSA_CRYPTO_DRIVER_ALG_CTR_CC3XX

config PSA_CRYPTO_DRIVER_ALG_DETERMINISTIC_ECDSA_OBERON
	bool
	prompt "PSA ECDSA support (deterministic mode) - oberon" if !PSA_PROMPTLESS
	default y if !PSA_DEFAULT_OFF && PSA_WANT_ALG_DETERMINISTIC_ECDSA && \
		     !PSA_CRYPTO_DRIVER_ALG_DETERMINISTIC_ECDSA_CC3XX

config PSA_CRYPTO_DRIVER_ALG_ECB_NO_PADDING_OBERON
	bool
	prompt "PSA AES ECB (no padding) - oberon" if !PSA_PROMPTLESS
	default y if !PSA_DEFAULT_OFF && PSA_WANT_ALG_ECB_NO_PADDING && \
		     !PSA_CRYPTO_DRIVER_ALG_ECB_NO_PADDING_CC3XX

config PSA_CRYPTO_DRIVER_ALG_ECDH_OBERON
	bool
	prompt "PSA ECDH support - oberon" if !PSA_PROMPTLESS
	default y if !PSA_DEFAULT_OFF && PSA_WANT_ALG_ECDH && \
		     !PSA_CRYPTO_DRIVER_ALG_ECDH_CC3XX

config PSA_CRYPTO_DRIVER_ALG_ECDSA_OBERON
	bool
	prompt "PSA ECDSA support - oberon" if !PSA_PROMPTLESS
	default y if !PSA_DEFAULT_OFF && PSA_WANT_ALG_ECDSA && \
		     !PSA_CRYPTO_DRIVER_ALG_ECDSA_CC3XX

config PSA_CRYPTO_DRIVER_ALG_GCM_OBERON
	bool
	prompt "PSA AES GCM support - OBERON" if !PSA_PROMPTLESS
	default y if !PSA_DEFAULT_OFF && PSA_WANT_ALG_GCM && \
		     !PSA_CRYPTO_DRIVER_ALG_GCM_CC3XX

# PSA_CRYPTO_DRIVER_ALG_HKDF_OBERON - Currently not supported

# PSA_CRYPTO_DRIVER_ALG_HMAC_OBERON - Currently not supported

config PSA_CRYPTO_DRIVER_ALG_SHA_1_OBERON
	bool
	prompt "PSA SHA1 support - oberon" if !PSA_PROMPTLESS
	default y if !PSA_DEFAULT_OFF && PSA_WANT_ALG_SHA_1 && \
		     !PSA_CRYPTO_DRIVER_ALG_SHA_1_CC3XX

config PSA_CRYPTO_DRIVER_ALG_SHA_224_OBERON
	bool
	prompt "PSA SHA-224 support - oberon" if !PSA_PROMPTLESS
	default y if !PSA_DEFAULT_OFF && PSA_WANT_ALG_SHA_224 && \
		     !PSA_CRYPTO_DRIVER_ALG_SHA_224_CC3XX

config PSA_CRYPTO_DRIVER_ALG_SHA_256_OBERON
	bool
	prompt "PSA SSH-256 support - oberon" if !PSA_PROMPTLESS
	default y if !PSA_DEFAULT_OFF && PSA_WANT_ALG_SHA_256 && \
		     !PSA_CRYPTO_DRIVER_ALG_SHA_256_CC3XX

config PSA_CRYPTO_DRIVER_ALG_SHA_384_OBERON
	bool
	prompt "PSA SHA-384 support - oberon" if !PSA_PROMPTLESS
	default y if !PSA_DEFAULT_OFF && PSA_WANT_ALG_SHA_384

config PSA_CRYPTO_DRIVER_ALG_SHA_512_OBERON
	bool
	prompt "PSA SHA-512 support - oberon" if !PSA_PROMPTLESS
	default y if PSA_WANT_ALG_SHA_512

config PSA_CRYPTO_DRIVER_ALG_STREAM_CIPHER_OBERON
	bool
	prompt "PSA stream cipher support - oberon" if !PSA_PROMPTLESS
	default y if !PSA_DEFAULT_OFF && PSA_WANT_ALG_STREAM_CIPHER && \
		     !PSA_CRYPTO_DRIVER_ALG_STREAM_CIPHER_CC3XX

config PSA_CRYPTO_DRIVER_ECC_MONTGOMERY_255_OBERON
	bool
	prompt "PSA ECC Curve25519 support - oberon" if !PSA_PROMPTLESS
	default y if !PSA_DEFAULT_OFF && PSA_WANT_ECC_MONTGOMERY_255 && \
		     !PSA_CRYPTO_DRIVER_ECC_MONTGOMERY_255_CC3XX

config PSA_CRYPTO_DRIVER_ECC_SECP_R1_224_OBERON
	bool
	prompt "PSA ECC secp224r1 - oberon" if !PSA_PROMPTLESS
	default y if !PSA_DEFAULT_OFF && PSA_WANT_ECC_SECP_R1_224 && \
		     !PSA_CRYPTO_DRIVER_ECC_SECP_R1_224_CC3XX

config PSA_CRYPTO_DRIVER_ECC_SECP_R1_256_OBERON
	bool
	prompt "PSA ECC secp256r1 - oberon" if !PSA_PROMPTLESS
	default y if !PSA_DEFAULT_OFF && PSA_WANT_ECC_SECP_R1_256 && \
		     !PSA_CRYPTO_DRIVER_ECC_SECP_R1_256_CC3XX

config PSA_CRYPTO_DRIVER_ECC_SECP_R1_384_OBERON
	bool
	prompt "PSA ECC secp384r1 - oberon" if !PSA_PROMPTLESS
	default y if !PSA_DEFAULT_OFF && PSA_WANT_ECC_SECP_R1_384 && \
		     !PSA_CRYPTO_DRIVER_ECC_SECP_R1_384_CC3XX

config PSA_CRYPTO_DRIVER_ECC_TWISTED_EDWARDS_255_OBERON
	bool
	prompt "PSA ECC Curve Ed25519 support - oberon" if !PSA_PROMPTLESS
	default y if !PSA_DEFAULT_OFF && PSA_WANT_ECC_TWISTED_EDWARDS_255

endif
```

## nrf_security/src/psa/Kconfig
```kconfig
#
# Copyright (c) 2021 Nordic Semiconductor ASA
#
# SPDX-License-Identifier: LicenseRef-Nordic-5-Clause
#

menuconfig PSA_NATIVE_ITS
	bool "PSA native Internal Trusted Storage"
	depends on CC310_BACKEND

if PSA_NATIVE_ITS

choice
	prompt "Backend selection for PSA native ITS"
	help
	  Select backend for PSA native Internal Trusted Storage

config CHOICE_BACKEND_ZEPHYR_SETTINGS
	bool "Zephyr Settings"
	select PSA_EITS_BACKEND_ZEPHYR

endchoice

menuconfig PSA_EITS_BACKEND_ZEPHYR
	bool "Native ITS backend based on Zephyr Settings subsystem"
	select FLASH
	select FLASH_MAP
	select FLASH_PAGE_LAYOUT
	select MPU_ALLOW_FLASH_WRITE
	select NVS
	select SETTINGS
	depends on CHOICE_BACKEND_ZEPHYR_SETTINGS
	help
	  Enable to get access for flashing operation based on Zephyr Settings
	  subsystem.

if PSA_EITS_BACKEND_ZEPHYR

config PSA_EITS_READ_BUFF_SIZE
	int "The size of the buffer used when reading with an offset"
	default 2048

module = PSA_EITS_BACKEND_ZEPHYR
module-str = PSA EITS Zephyr backend
source "${ZEPHYR_BASE}/subsys/logging/Kconfig.template.log_config"

endif # PSA_EITS_BACKEND_ZEPHYR

endif # PSA_NATIVE_ITS
```

## nrf_security/sst_settings/Kconfig
```kconfig
#
# Copyright (c) 2020 Nordic Semiconductor ASA
#
# SPDX-License-Identifier: LicenseRef-BSD-5-Clause-Nordic
#
config SST_SETTINGS
	bool "Settings module for Secure Storage"
	help
	  Enable to get access for flashin operation based on Settings subsys.

if SST_SETTINGS

module = SST_SETTINGS
module-str = Secure Storage Settings
source "${ZEPHYR_BASE}/subsys/logging/Kconfig.template.log_config"

endif
```
