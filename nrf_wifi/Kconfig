## nrf_wifi/Kconfig
```kconfig
#
# Copyright (c) 2024 Nordic Semiconductor
#
# SPDX-License-Identifier: BSD-3-Clause
#
menu "Nordic nRF70 Wi-Fi configuration"

config NRF_WIFI
	bool "Enable nRF70 OS agnostic library"
	help
	  Enable the nRF70 OS agnostic library.

config NRF70_RADIO_TEST
	bool "Enable nRF70 radio test"
	help
	  Enable the nRF70 radio test.

endmenu
```

## openthread/Kconfig
```kconfig
#
# Copyright (c) 2020 Nordic Semiconductor
#
# SPDX-License-Identifier: LicenseRef-Nordic-5-Clause
#

if NET_L2_OPENTHREAD

menu "OpenThread"

# OPENTHREAD_IMPLEMENTATION is declared in Zephyr and also here for a second time,
# now with additional properties. Note that the dependencies of the
# original config must be duplicated to not affect it's visibility.

choice OPENTHREAD_IMPLEMENTATION
	prompt "OpenThread origin selection"
	default OPENTHREAD_SOURCES
	help
	  Select OpenThread to use for build. Custom OpenThread implementations
	  can be added to the application Kconfig.

config OPENTHREAD_LIBRARY
	bool "OpenThread from library"
	select OPENTHREAD_NORDIC_LIBRARY
	help
	  Build OpenThread from a prebuilt library instead of building from sources.
	  CONFIG_OPENTHREAD_THREAD_VERSION determines which version of the library is to be used.

config OPENTHREAD_LIBRARY_1_1
	bool "(Legacy) OpenThread 1.1 from library"
	depends on OPENTHREAD_THREAD_VERSION_1_1
	select OPENTHREAD_NORDIC_LIBRARY
	help
	  Legacy option to use prebuilt OpenThread 1.1 library.

endchoice

# OpenThread configuration features sets from Nordic Semiconductor

config OPENTHREAD_NORDIC_LIBRARY
	bool "Nordic library feature sets"
	depends on !OPENTHREAD_SOURCES

config OPENTHREAD_NORDIC_LIBRARY_COMMON
	bool "Common OpenThread features"
	select OPENTHREAD_COAP
	select OPENTHREAD_DNS_CLIENT
	select OPENTHREAD_ECDSA
	select OPENTHREAD_EXTERNAL_HEAP
	select OPENTHREAD_IP6_FRAGM
	select OPENTHREAD_NETDIAG_CLIENT
	select OPENTHREAD_SLAAC
	select OPENTHREAD_SRP_CLIENT
	select OPENTHREAD_DUA if !OPENTHREAD_THREAD_VERSION_1_1
	select OPENTHREAD_MLR if !OPENTHREAD_THREAD_VERSION_1_1
	select OPENTHREAD_NETDIAG_VENDOR_INFO if OPENTHREAD_THREAD_VERSION_1_4
	help
	  Common set of features for the OpenThread stack provided by Nordic Semiconductor.

choice OPENTHREAD_NORDIC_LIBRARY_CONFIGURATION
	prompt "Feature set"
	default OPENTHREAD_USER_CUSTOM_LIBRARY
	help
	  Nordic Semiconductor features set selection for OpenThread stack.

config OPENTHREAD_NORDIC_LIBRARY_MASTER
	bool "Nordic OpenThread master configuration"
	select OPENTHREAD_NORDIC_LIBRARY_COMMON
	select OPENTHREAD_COAPS
	select OPENTHREAD_COMMISSIONER
	select OPENTHREAD_DIAG
	select OPENTHREAD_DHCP6_SERVER
	select OPENTHREAD_DHCP6_CLIENT
	select OPENTHREAD_ENABLE_SERVICE
	select OPENTHREAD_JAM_DETECTION
	select OPENTHREAD_JOINER
	select OPENTHREAD_MAC_FILTER
	select OPENTHREAD_RAW
	select OPENTHREAD_SNTP_CLIENT
	select OPENTHREAD_SRP_CLIENT
	select OPENTHREAD_UDP_FORWARD
	select OPENTHREAD_LINK_METRICS_INITIATOR if !OPENTHREAD_THREAD_VERSION_1_1
	select OPENTHREAD_LINK_METRICS_SUBJECT if !OPENTHREAD_THREAD_VERSION_1_1
	select OPENTHREAD_CSL_RECEIVER if !OPENTHREAD_THREAD_VERSION_1_1
	select OPENTHREAD_TCP_ENABLE if OPENTHREAD_THREAD_VERSION_1_4
	select OPENTHREAD_DNS_CLIENT_OVER_TCP if OPENTHREAD_THREAD_VERSION_1_4
	help
	  Nordic Semiconductor complete set of OpenThread features.

config OPENTHREAD_NORDIC_LIBRARY_FTD
	bool "Nordic Optimized FTD configuration"
	select OPENTHREAD_NORDIC_LIBRARY_COMMON
	select OPENTHREAD_LINK_METRICS_SUBJECT if !OPENTHREAD_THREAD_VERSION_1_1
	help
	  Nordic Semiconductor optimized OpenThread features for FTD.

config OPENTHREAD_NORDIC_LIBRARY_MTD
	bool "Nordic Optimized MTD configuration"
	select OPENTHREAD_NORDIC_LIBRARY_COMMON
	select OPENTHREAD_CSL_RECEIVER if !OPENTHREAD_THREAD_VERSION_1_1
	help
	  Nordic Semiconductor optimized OpenThread features for MTD.

config OPENTHREAD_NORDIC_LIBRARY_RCP
	bool "Nordic OpenThread RCP configuration"
	select OPENTHREAD_LINK_METRICS_INITIATOR if !OPENTHREAD_THREAD_VERSION_1_1
	select OPENTHREAD_LINK_METRICS_SUBJECT if !OPENTHREAD_THREAD_VERSION_1_1
	select OPENTHREAD_CSL_RECEIVER if !OPENTHREAD_THREAD_VERSION_1_1
	help
	   Nordic Semiconductor optimized OpenThread features for RCP.

config OPENTHREAD_USER_CUSTOM_LIBRARY
	bool "User custom configuration"
	help
	  No extra features selected.

endchoice

config OPENTHREAD_BUILD_OUTPUT_STRIPPED
	bool "Strip OpenThread libraries"
	help
	  Build a stripped library versions of OpenThread in the build directory.

config OPENTHREAD_NRFXLIB_RELEASE_TAG
	string "Release tag for OpenThread libraries"
	default "Not specified"
	help
	  The release tag will be added to the openthread_lib_configuration.txt file
	  within the OpenThread library directory. 

endmenu # "OpenThread"

endif
```

## serialization/Kconfig
```kconfig
#
# Copyright (c) 2020 Nordic Semiconductor
#
# SPDX-License-Identifier: LicenseRef-BSD-5-Clause-Nordic
#

menuconfig RP_SERIALIZATION
	bool "Serialization library"
	help
	  Enable serialization library, with a chosen transport layer

if RP_SERIALIZATION

choice
	prompt "Serialization transport layer"
	default RPMSG_TRANSPORT

config RPMSG_TRANSPORT
	bool "Serialization RPMsg transport"

endchoice

endif # RP_SERIALIZATION
```

## sm_ipt/Kconfig
```kconfig
#
# Copyright (c) 2021 Nordic Semiconductor
#
# SPDX-License-Identifier: LicenseRef-Nordic-5-Clause
#

menuconfig SM_IPT
	bool "Shared memory Inter-Processor Transport"
	help
	  Enable Shared memory Inter-Processor Transport library

if SM_IPT

choice
	prompt "Shared memory blocks"
	default SM_IPT_NUM_BLOCKS_32

config SM_IPT_NUM_BLOCKS_32
	bool "32"
	help
	  Selects 32 shared memory blocks per single input or output channel.

config SM_IPT_NUM_BLOCKS_64
	bool "64"
	help
	  Selects 64 shared memory blocks per single input or output channel.
	  This will increase allocatable memory granularity, but it will have
	  some impact on performance and code size.

endchoice

config SM_IPT_PRIMARY
	bool "Primary role"
	help
	  One side must have primary role (this option selected) and the other
	  side must have secondary role. Shared memory layout depends on this configuration.

module = SM_IPT
module-str = SM IPT
source "${ZEPHYR_BASE}/subsys/logging/Kconfig.template.log_config"

endif # SM_IPT
```

## softdevice_controller/Kconfig
```kconfig
#
# Copyright (c) 2018 Nordic Semiconductor
#
# SPDX-License-Identifier: LicenseRef-Nordic-5-Clause
#

# BT_LL_CHOICE is declared in Zephyr and also here for a second time,
# now with additional properties. Note that the dependencies of the
# original config must be duplicated to not affect it's visibility.

if BT && BT_HCI

config BT_LL_SOFTDEVICE_VS_INCLUDE
	bool "Include SoftDevice Controller vendor specific HCI interface"
	help
	  Include SoftDevice Controller vendor specific HCI interface.

config BT_LL_SOFTDEVICE_DEFAULT
	bool "Select BT_LL_SOFTDEVICE as default BT_LL_CHOICE"
	help
	  Helper variable used to change the default link layer if
	  BT_CTLR is supported for the platform.

if BT_CTLR

config BT_CTLR_LLPM
	bool "Enable Low Latency Packet Mode support"
	depends on SOC_SERIES_NRF52X
	help
	  Low Latency Packet Mode (LLPM) is a Nordic proprietary addition
	  which lets the application use connection intervals down to 1 ms.

choice BT_LL_CHOICE
	prompt "Bluetooth Link Layer Selection"
	default BT_LL_SOFTDEVICE

config BT_LL_SOFTDEVICE
	bool "SoftDevice Link Layer"
	select MPSL
	select ZERO_LATENCY_IRQS
	select BT_CTLR_LE_ENC_SUPPORT
	select BT_CTLR_EXT_REJ_IND_SUPPORT
	select BT_CTLR_PRIVACY_SUPPORT
	select BT_CTLR_EXT_SCAN_FP_SUPPORT
	select BT_CTLR_PHY_UPDATE_SUPPORT
	select BT_CTLR_CHAN_SEL_2_SUPPORT
	select BT_CTLR_CONN_RSSI_SUPPORT
	select BT_CTLR_DATA_LEN_UPDATE_SUPPORT
	select BT_CTLR_ADV_EXT_SUPPORT
	select BT_CTLR_PHY_2M_SUPPORT if HAS_HW_NRF_RADIO_BLE_2M
	select BT_CTLR_PHY_CODED_SUPPORT if HAS_HW_NRF_RADIO_BLE_CODED
	select BT_HAS_HCI_VS
	# The SoftDevice Controller only supports nRF52 and nRF53, it does not support nRF51
	# or nRF91 (nRF91 doesn't even have the physical HW needed for BLE).
	depends on (SOC_SERIES_NRF52X || SOC_NRF5340_CPUNET)
	help
	  Use SoftDevice Link Layer implementation.

endchoice


if BT_LL_SOFTDEVICE

comment "Common SoftDevice Controller module configuration"

choice SOFTDEVICE_CONTROLLER_VARIANT
	prompt "SoftDevice Controller variant"
	default SOFTDEVICE_CONTROLLER_MULTIROLE if ((BT_OBSERVER && BT_BROADCASTER) || \
						     BT_CTLR_LLPM || \
						     BT_CTLR_ADV_EXT || \
						     BT_CTLR_PHY_CODED || \
						     SOC_NRF5340_CPUNET)
	default SOFTDEVICE_CONTROLLER_CENTRAL if BT_OBSERVER
	default SOFTDEVICE_CONTROLLER_PERIPHERAL if BT_BROADCASTER
	help
	  Select a SoftDevice Controller variant.

config SOFTDEVICE_CONTROLLER_PERIPHERAL
	bool "SoftDevice Controller peripheral library optimized for peripheral role applications"
	depends on !BT_OBSERVER && !BT_CTLR_LLPM && !BT_CTLR_ADV_EXT && !BT_CTLR_PHY_CODED
	help
	  The peripheral library variant is optimized for simpler applications only
	  requiring the peripheral role.

config SOFTDEVICE_CONTROLLER_CENTRAL
	bool "SoftDevice Controller optimized for central role applications"
	depends on !BT_BROADCASTER && !BT_CTLR_LLPM && !BT_CTLR_ADV_EXT && !BT_CTLR_PHY_CODED
	help
	  The central library variant is optimized for simpler applications only
	  requiring the central role.

config SOFTDEVICE_CONTROLLER_MULTIROLE
	bool "SoftDevice Controller optimized for multirole and other advanced configurations"
	help
	  The multirole library variant is contains all supported features and can be used
	  for more advanced applications. Using this library may give slightly larger applications.
	  However, the library is designed in such a way that unused functionality is removed
	  by the linker.

endchoice


endif # BT_LL_SOFTDEVICE
endif # BT_CTLR
endif # BT && BT_HCI
```

## zboss/Kconfig
```kconfig
#
# Copyright (c) 2021 Nordic Semiconductor
#
# SPDX-License-Identifier: LicenseRef-Nordic-5-Clause
#

if ZIGBEE

menu "ZBOSS library configuration"

config ZBOSS_SOURCES_AVAILABLE
	bool

# Select between the production and development version of libraries
choice ZIGBEE_LIBRARY_TYPE
	bool "ZBOSS library version"
	default ZIGBEE_LIBRARY_PRODUCTION

config ZIGBEE_LIBRARY_PRODUCTION
	bool "Use production libraries"
	help
	  If selected, the application will be linked with the latest, stable
	  version of ZBOSS libraries.
	  Please check NCS documentation in order to get the certification status
	  of those libraries.

config ZIGBEE_LIBRARY_DEVELOPMENT
	bool "Use development libraries [DEPRECATED]"
	select DEPRECATED
	help
	  If selected, the application will be linked with newest version of
	  ZBOSS libraries.
	  Those libraries are not officially certified, but may be used for
	  an early development of applications, that require experimental features.

endchoice # ZIGBEE_LIBRARY_TYPE

# Add a menu option to switch between platform designs.
choice
	prompt "Zigbee platform design"
	default ZIGBEE_LIBRARY_SOC

config ZIGBEE_LIBRARY_SOC
	bool "System-on-Chip"
	help
	  The Zigbee stack, as well as the application is implemented on the SoC

config ZIGBEE_LIBRARY_NCP_DEV
	bool "Network co-processor (connectivity device)"
	help
	  The Zigbee stack is implemented on the connectivity SoC,
	  but the application is implemented on the host MCU

endchoice

# Add a menu option to switch between subsets of Zigbee Green Power features.
choice
	prompt "Zigbee Green Power feature set configuration"
	default ZIGBEE_GP_PB

config ZIGBEE_GP_NONE
	bool "Disable Zigbee Green Power functionality"
	help
	  This option is valid only when building ZBOSS without application layer

config ZIGBEE_GP_PB
	bool "Enable Zigbee Green Power Proxy Basic functionality"

config ZIGBEE_GP_CB
	bool "Enable Zigbee Green Power Combo Basic functionality [EXPERIMENTAL]"
	select EXPERIMENTAL
	depends on !ZIGBEE_ROLE_END_DEVICE && ZBOSS_SOURCES_AVAILABLE

endchoice

config ZIGBEE_ENABLE_TRACES
	bool "Use ZBOSS libraries, dedicated for debugging issues [EXPERIMENTAL]"
	select EXPERIMENTAL
	help
	  Those libraries do not include additional debug symbols, but they include
	  extended set of ZBOSS binary traces, that allow Nordic's support team to debug issues.

config APP_LINK_WITH_ZBOSS
	bool
	help
	  Link application with ZBOSS library

endmenu

endif #ZIGBEE
```

## zboss/production/Kconfig
```kconfig
#
# Copyright (c) 2021 Nordic Semiconductor
#
# SPDX-License-Identifier: LicenseRef-Nordic-5-Clause
#

config APP_LINK_WITH_ZBOSS
	bool
	help
	  Link application with ZBOSS library
```
