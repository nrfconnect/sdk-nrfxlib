/*
 * Copyright (c) 2026 Nordic Semiconductor ASA
 *
 * SPDX-License-Identifier: LicenseRef-Nordic-5-Clause
 */

/* Layouts without MCUboot. */

#ifdef USE_NON_SECURE_ADDRESS_MAP
#include "../../../../nrf71_wifi/bins/0.1.0/ns/nrf7120_wifi_patch.dtsi"
#else
#include "../../../../nrf71_wifi/bins/0.1.0/secure/nrf7120_wifi_patch.dtsi"
#endif
